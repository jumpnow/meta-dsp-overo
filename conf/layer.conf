## conf/layer.conf
```bitbake
# We have a conf and classes directory, append to BBPATH
BBPATH .= ":${LAYERDIR}"

BBFILES += "${LAYERDIR}/recipes*/*/*.bb ${LAYERDIR}/recipes*/*/*.bbappend ${LAYERDIR}/images/*.bb"

BBFILE_COLLECTIONS += "meta-dsp-overo"
BBFILE_PATTERN_meta-dsp-overo := "^${LAYERDIR}/"
BBFILE_PRIORITY_meta-dsp-overo = "16"
```
